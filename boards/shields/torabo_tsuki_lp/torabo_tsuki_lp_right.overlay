#include "torabo_tsuki_lp.dtsi"
#include <input/processors.dtsi>
#include <dt-bindings/zmk/input_transform.h>

&pointing_listener {
    input-processors = <
        &zip_xy_transform
        (INPUT_TRANSFORM_X_INVERT | INPUT_TRANSFORM_Y_INVERT)
    >;
};

&size_xs_transform {
    col-offset = <7>;
};

&encoder_right {
    status = "okay";
};